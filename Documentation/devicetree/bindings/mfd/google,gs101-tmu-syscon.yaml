## Documentation/devicetree/bindings/mfd/google,gs101-tmu-syscon.yaml
```yaml
# SPDX-License-Identifier: (GPL-2.0-only OR BSD-2-Clause)
%YAML 1.2
---
$id: http://devicetree.org/schemas/mfd/google,gs101-tmu-syscon.yaml#
$schema: http://devicetree.org/meta-schemas/core.yaml#

title: Google GS101 TMU System Controller

maintainers:
  - Tudor Ambarus <tudor.ambarus@linaro.org>

description: |
  The TMU System Controller provides a memory-mapped interface for
  accessing the interrupt status registers of the Thermal Management
  Unit. It is used as a syscon provider for the main TMU driver.

properties:
  compatible:
    items:
      - const: google,gs101-tmu-syscon
      - const: syscon

  reg:
    maxItems: 1

required:
  - compatible
  - reg

additionalProperties: false

examples:
  - |
    syscon@100a0000 {
        compatible = "google,gs101-tmu-syscon", "syscon";
        reg = <0x100a0000 0x800>;
    };
```

## Documentation/devicetree/bindings/nvmem/google,gs101-otp.yaml
```yaml
# SPDX-License-Identifier: (GPL-2.0-only OR BSD-2-Clause)
%YAML 1.2
---
$id: http://devicetree.org/schemas/nvmem/google,gs101-otp.yaml#
$schema: http://devicetree.org/meta-schemas/core.yaml#

title: Google GS101 OTP Controller

maintainers:
  - Tudor Ambarus <tudor.ambarus@linaro.org>

description: |
  OTP controller drives a NVMEM memory where system or user specific data
  can be stored. The OTP controller contains dedicated registers for the
  Product ID and Chip ID.

allOf:
  - $ref: nvmem.yaml#
  - $ref: nvmem-deprecated-cells.yaml

properties:
  compatible:
    items:
      - const: google,gs101-otp

  reg:
    maxItems: 1

  clocks:
    maxItems: 1

  clock-names:
    const: pclk

required:
  - compatible
  - reg
  - clock-names
  - clocks

unevaluatedProperties: false

examples:
  - |
    #include <dt-bindings/clock/google,gs101.h>

    otp: efuse@10000000 {
        compatible = "google,gs101-otp";
        reg = <0x10000000 0xf084>;
        #address-cells = <1>;
        #size-cells = <1>;
        clocks = <&cmu_misc CLK_GOUT_MISC_OTP_CON_TOP_PCLK>;
        clock-names = "pclk";

        product_id: product_id@0 {
            reg = <0x0 0x4>;
        };

        chip_id: chip-id@4 {
            reg = <0x4 0x10>;
        };
    };
```

## Documentation/devicetree/bindings/thermal/google,gs101-tmu-top.yaml
```yaml
# SPDX-License-Identifier: (GPL-2.0-only OR BSD-2-Clause)
%YAML 1.2
---
$id: http://devicetree.org/schemas/thermal/google,gs101-tmu-top.yaml#
$schema: http://devicetree.org/meta-schemas/core.yaml#

title: Google GS101 Thermal Management Unit (TMU)

maintainers:
  - Tudor Ambarus <tudor.ambarus@linaro.org>

description: |
  The Google GS101 TMU is a thermal sensor block managed via the ACPM
  (Active Core Power Management) firmware. While the firmware handles
  the thermal algorithm and thresholds, the kernel requires direct
  access to the interrupt pending registers via a syscon interface to
  acknowledge and clear thermal interrupts.

properties:
  compatible:
    const: google,gs101-tmu-top

  clocks:
    maxItems: 1
    description: |
      Phandle to the APB peripheral clock (PCLK) required to access
      the TMU registers.

  interrupts:
    maxItems: 1
    description: |
      The combined thermal interrupt signal (Level High).

  syscon:
    $ref: /schemas/types.yaml#/definitions/phandle
    description: |
      Phandle to the device node representing the TMU System Controller
      (compatible with "google,gs101-tmu-syscon"). This node provides the
      regmap for INTPEND and INTCLEAR registers.

  "#thermal-sensor-cells":
    const: 1

required:
  - compatible
  - clocks
  - interrupts
  - syscon
  - "#thermal-sensor-cells"

additionalProperties: false

examples:
  - |
    #include <dt-bindings/interrupt-controller/arm-gic.h>
    #include <dt-bindings/clock/google,gs101.h>

    thermal-sensor {
        compatible = "google,gs101-tmu-top";
        clocks = <&cmu_misc CLK_GOUT_MISC_TMU_TOP_PCLK>;
        interrupts = <GIC_SPI 769 IRQ_TYPE_LEVEL_HIGH 0>;
        syscon = <&tmu_top_syscon>;
        #thermal-sensor-cells = <1>;
    };
```

## drivers/thermal/samsung/Kconfig
```kconfig
# SPDX-License-Identifier: GPL-2.0-only
config EXYNOS_THERMAL
	tristate "Exynos thermal management unit driver"
	depends on THERMAL_OF
	depends on HAS_IOMEM
	help
	  If you say yes here you get support for the TMU (Thermal Management
	  Unit) driver for Samsung Exynos series of SoCs. This driver initialises
	  the TMU, reports temperature and handles cooling action if defined.
	  This driver uses the Exynos core thermal APIs and TMU configuration
	  data from the supported SoCs.

config EXYNOS_ACPM_THERMAL
	tristate "Exynos ACPM thermal management unit driver"
	depends on THERMAL_OF
	depends on EXYNOS_ACPM_PROTOCOL || (COMPILE_TEST && !EXYNOS_ACPM_PROTOCOL)
	help
	  Support for the Thermal Management Unit (TMU) on Exynos Google
	  GS101 SoC.

	  The TMU on GS101 is managed by the Alive Clock and Power Manager
	  (ACPM) firmware. This driver handles the kernel-side interaction,
	  including reading interrupt status registers via syscon and
	  communicating with the firmware via the ACPM protocol for
	  configuration and thermal events.

	  Select this if you want to monitor device temperature and enable
	  thermal mitigation on GS101-based devices.
```
